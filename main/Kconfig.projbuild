## main/Kconfig.projbuild
```kconfig
menu "Fridge Sensor Configuration"

    config SENSOR_URL
        string "Sensor POST URL"
        default ""
        help
            Set the POST URL to send sensor data
endmenu
```
